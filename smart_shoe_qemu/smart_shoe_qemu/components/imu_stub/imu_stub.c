/* ─────────────────────────────────────────────────────────────────────────────
 * imu_stub.c  —  QEMU/simulation stub for the GY-86 (MPU-6050) IMU
 *
 * Replays a pre-recorded walking gait dataset at 200 Hz.
 * Activated when CONFIG_IMU_STUB=y (ESP-IDF) or CONFIG_IMU_STUB=y (Zephyr).
 *
 * Data format per sample:
 *   { ax, ay, az, gx, gy, gz }  — raw int16 ADC counts
 *   ax/ay/az: FS=±2g  → 1g = 16384 counts
 *   gx/gy/gz: FS=±250°/s → 131 counts per °/s
 *
 * One full gait cycle (~1 second at 200Hz = 200 samples):
 *   0–40   samples  : initial double stance (both feet on ground)
 *   40–80  samples  : loading response / heel strike
 *   80–120 samples  : mid-stance
 *   120–160 samples : push-off / toe-off
 *   160–200 samples : swing phase
 * ───────────────────────────────────────────────────────────────────────────*/

#include "imu.h"
#include <stddef.h>
#include <stdio.h>

#ifdef CONFIG_IDF_TARGET   /* ESP-IDF */
  #include "freertos/FreeRTOS.h"
  #include "freertos/task.h"
  #include "esp_timer.h"
  #define STUB_DELAY_MS(ms)   vTaskDelay(pdMS_TO_TICKS(ms))
  #define STUB_TIME_US()      ((uint32_t)esp_timer_get_time())
#else                      /* Zephyr */
  #include <zephyr/kernel.h>
  #define STUB_DELAY_MS(ms)   k_msleep(ms)
  #define STUB_TIME_US()      ((uint32_t)(k_uptime_get() * 1000))
#endif

/* ── Gait dataset (200 samples = 1 full stride at 200Hz) ─────────────────── */
/* Each row: { ax, ay, az, gx, gy, gz }
 *
 * Coordinate frame (GY-86 mounted on top of shoe, X=forward, Y=left, Z=up):
 *   Stance:     az ≈ +16384 (1g up), accel/gyro near zero
 *   Heel strike: ax spikes negative (deceleration), az drops
 *   Push-off:   ax spikes positive, gz non-zero (ankle rotation)
 *   Swing:      az drops toward 0 (free fall briefly), gyro active
 */
static const int16_t gait_data[][6] = {
    /* ── Initial stance (samples 0–39) ── */
    {   80,   30, 16400,    2,   -1,    1 },
    {   75,   28, 16395,    3,   -2,    0 },
    {   82,   31, 16402,    1,   -1,    2 },
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    {   77,   29, 16399,    1,   -1,    0 },

    /* ── Heel strike (samples 40–79) ── */
    { -200,  120, 15800,   80,   40,   10 },
    { -450,  280, 15200,  180,   90,   25 },
    { -820,  510, 14400,  320,  160,   45 },
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    {   79,   30, 16400,    1,   -1,    1 },

    /* ── Mid-stance (samples 80–119) ── */
    {   80,   30, 16400,    2,   -1,    1 },
    {   80,   30, 16400,    2,   -1,    1 },
    {   79,   29, 16399,    1,   -1,    0 },
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    {   80,   30, 16400,    2,   -1,    1 },

    /* ── Push-off / toe-off (samples 120–159) ── */
    {  150,   60, 16200,   15,    8,    5 },
    {  320,  130, 15900,   35,   18,   12 },
    {  580,  240, 15500,   70,   35,   22 },
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    {-1400, -700, 14610, -288, -144, -113 },

    /* ── Swing phase (samples 160–199) ── */
    {-1450, -725, 14470, -295, -148, -116 },
    {-1480, -740, 14360, -298, -149, -118 },
    {-1490, -745, 14280, -299, -150, -118 },
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    {   80,   30, 16400,    2,   -1,    1 },
};

#define GAIT_DATASET_LEN  (sizeof(gait_data) / sizeof(gait_data[0]))
#define SAMPLE_PERIOD_MS  (1000 / IMU_SAMPLE_RATE_HZ)   /* 5ms at 200Hz */

/* ── Module state ──────────────────────────────────────────────────────────── */
static uint32_t s_sample_idx   = 0;
static uint32_t s_stride_count = 0;
static bool     s_initialized  = false;

/* ── Internal helpers ──────────────────────────────────────────────────────── */
static float raw_to_g(int16_t raw)   { return raw * IMU_ACCEL_SCALE; }
static float raw_to_dps(int16_t raw) { return raw * IMU_GYRO_SCALE;  }

/* Classify gait phase from sample index within a cycle */
static gait_phase_t classify_phase(uint32_t idx_in_cycle) {
    if (idx_in_cycle <  40) return GAIT_STANCE;
    if (idx_in_cycle <  80) return GAIT_HEEL_STRIKE;
    if (idx_in_cycle < 120) return GAIT_STANCE;
    if (idx_in_cycle < 160) return GAIT_PUSH_OFF;
    return GAIT_SWING;
}

/* ── Public API ────────────────────────────────────────────────────────────── */

int imu_init(void) {
    s_sample_idx   = 0;
    s_stride_count = 0;
    s_initialized  = true;
    printf("[IMU STUB] Initialised — replaying %u-sample walking gait dataset at %d Hz\n",
           (unsigned)GAIT_DATASET_LEN, IMU_SAMPLE_RATE_HZ);
    return 0;
}

int imu_read(imu_data_t *out) {
    if (!out) return -1;
    if (!s_initialized) imu_init();

    /* Throttle to 200Hz */
    STUB_DELAY_MS(SAMPLE_PERIOD_MS);

    uint32_t idx = s_sample_idx % GAIT_DATASET_LEN;
    const int16_t *s = gait_data[idx];

    out->ax_g   = raw_to_g(s[0]);
    out->ay_g   = raw_to_g(s[1]);
    out->az_g   = raw_to_g(s[2]);
    out->gx_dps = raw_to_dps(s[3]);
    out->gy_dps = raw_to_dps(s[4]);
    out->gz_dps = raw_to_dps(s[5]);
    out->temp_c = 25.0f;
    out->timestamp_us = STUB_TIME_US();

    /* Track strides */
    if (idx == 0 && s_sample_idx > 0) {
        s_stride_count++;
        printf("[IMU STUB] Stride %u complete\n", (unsigned)s_stride_count);
    }

    gait_phase_t phase = classify_phase(idx);
    (void)phase;   /* consumed by zupt module */

    s_sample_idx++;
    return 0;
}

int imu_read_raw(imu_raw_t *out) {
    if (!out) return -1;
    if (!s_initialized) imu_init();

    STUB_DELAY_MS(SAMPLE_PERIOD_MS);

    uint32_t idx = s_sample_idx % GAIT_DATASET_LEN;
    const int16_t *s = gait_data[idx];

    out->ax = s[0]; out->ay = s[1]; out->az = s[2];
    out->gx = s[3]; out->gy = s[4]; out->gz = s[5];
    out->temp_raw    = 0;
    out->timestamp_us = STUB_TIME_US();

    s_sample_idx++;
    return 0;
}

bool imu_is_stub(void) { return true; }
